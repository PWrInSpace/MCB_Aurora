## components/commands/Kconfig.projbuild
```kconfig
menu "Commands task"
#define CMD_TASK_CORE_ID CONFIG_CMD_TASK_CORE_ID
    config CMD_RECEIVE_QUEUE_SIZE
        int "Receive queue size"
        default 10

    config CMD_TASK_STACK_DEPTH
        int "Task stack depth"
        default 8000

    config CMD_TASK_PRIORITY
        int "Task priority"
        range 0 20
        default 2

    config CMD_TASK_CORE_ID
        int "Task core"
        range 0 1
        default 0

endmenu
```

## components/errors/Kconfig.projbuild
```kconfig
menu "Errors"
    config MAX_NUMBER_OF_ERRORS
        int "Max number of errors"
        default 8

endmenu
```

## components/esp_now/Kconfig.projbuild
```kconfig
menu "Esp now API"
    config MAX_NUMBER_OF_DEVICE
        int "Max number of devices"
        default 8

    config ESP_NOW_TASK_STACK_DEPTH
        int "Task stack depth"
        default 8000

    config ESP_NOW_TASK_PRIORITY
        int "Task priority"
        range 0 20
        default 2

    config ESP_NOW_TASK_CORE_ID
        int "Task core"
        range 0 1
        default 0

endmenu
```

## components/flash_memory/Kconfig.projbuild
```kconfig
menu "Flash Task"
    config FLASH_DIR
        string "Flash directiory"
        default "/spiffs"

    config FLASH_FILE
        string "Flash file name"
        default "flash"

    config FLASH_QUEUE_SIZE
        int "Flash data queue size"
        default 20

    config FLASH_DATA_DROP_VALUE
        int "Data drop value"
        range 0 FLASH_QUEUE_SIZE
        default 10

    config FLASH_TASK_STACK_DEPTH
        int "task stack depth"
        default 8100

    config FLASH_TASK_PRIORITY
        int "task priority"
        range 0 20
        default 5

    config FLASH_TASK_CORE_ID
        int "task core id"
        range 0 1
        default 1
endmenu
```

## components/gps/Kconfig.projbuild
```kconfig
menu "GPS task"
    config GPS_TASK_DEPTH
        int "GPS task stack depth"
        default 4096

    config GPS_TASK_PRIORITY
        int "GPS task prioirty"
        range 0 20
        default 2

    config GPS_TASK_CPU
        int "GPS task cpu number"
        range 0 1
        default 1

    config GPS_TASK_PERIOD_MS
        int "GPS task loop execution period (ms)"
        range 0 60000
        default 1000
endmenu
```

## components/lora/Kconfig.projbuild
```kconfig
menu "Lora"
    config LORA_FREQUENCY_KHZ
        int "Lora frequency kHz"
        default 868000

    config LORA_BANDWIDTH
        int "Lora bandwidth"
        default 8

    config LORA_SPREADING_FACTOR
        int "Lora spreading factor"
        default 1

    config LORA_CRC_ENABLE
        int "enable crc"
        range 0 1
        default 0

    config LORA_RECEIVE_WINDOW
        int "receive window time ms"
        default 1500

    config LORA_TASK_STACK_DEPTH
        int "task stack depth"
        default 8100

    config LORA_TASK_PRIORITY
        int "task priority"
        range 0 20
        default 5

    config LORA_TASK_CORE_ID
        int "task core id"
        range 0 1
        default 0
endmenu
```

## components/memory/Kconfig.projbuild
```kconfig
menu "Flash Task"
    config FLASH_DIR
        string "Flash directiory"
        default "/spiffs"

    config FLASH_FILE
        string "Flash file name"
        default "flash"

    config FLASH_QUEUE_SIZE
        int "Flash data queue size"
        default 20

    config FLASH_DATA_DROP_VALUE
        int "Data drop value"
        range 0 FLASH_QUEUE_SIZE
        default 10
endmenu

menu "SD Task"

    config SD_DATA_BUFFER_MAX_SIZE
        int "data buffer size"
        default 256

    config SD_LOG_BUFFER_MAX_SIZE
        int "log buffer size"
        default 256

    config SD_MOUNT_POINT
        string "mount_point"
        default "/sdcard"

    config SD_DATA_QUEUE_SIZE
        int "Data queue size"
        default 20

    config SD_LOG_QUEUE_SIZE
        int "Log queue size"
        default 20

    config SD_PATH_SIZE
        int "Path size"
        default 40

    config SD_DATA_DROP_VALUE
        int "Data drop value"
        range 0 SD_DATA_QUEUE_SIZE
        default 10
endmenu
```

## components/sd_card/Kconfig.projbuild
```kconfig
menu "SD Task"

    config SD_DATA_BUFFER_MAX_SIZE
        int "data buffer size"
        default 256

    config SD_LOG_BUFFER_MAX_SIZE
        int "log buffer size"
        default 256

    config SD_MOUNT_POINT
        string "mount_point"
        default "/sdcard"

    config SD_DATA_QUEUE_SIZE
        int "Data queue size"
        default 20

    config SD_LOG_QUEUE_SIZE
        int "Log queue size"
        default 20

    config SD_PATH_SIZE
        int "Path size"
        default 40

    config SD_DATA_DROP_VALUE
        int "Data drop value"
        range 0 SD_DATA_QUEUE_SIZE
        default 10
endmenu
```

## components/sensors/Kconfig.projbuild
```kconfig
menu "Sensors task"
    config SENSORS_TASK_DEPTH
        int "Sensors task stack depth"
        default 4096

    config SENSORS_TASK_PRIORITY
        int "Sensors task prioirty"
        range 0 20
        default 2

    config SENSORS_TASK_CPU
        int "Sensor task cpu number"
        range 0 1
        default 1

    config SENSORS_TASK_PERIOD_MS
        int "Sensor task loop execution period (ms)"
        range 0 10000
        default 10
endmenu

menu "Recovery task"
    config RECOVERY_TASK_DEPTH
        int "Recovery task stack depth"
        default 4096

    config RECOVERY_TASK_PRIORITY
        int "Recovery task prioirty"
        range 0 20
        default 2

    config RECOVERY_TASK_CPU
        int "Recovery task cpu number"
        range 0 1
        default 1

    config RECOVERY_TASK_PERIOD_MS
        int "Recovery task loop execution period (ms)"
        range 0 10000
        default 500
endmenu
```

## components/sys/Kconfig.projbuild
```kconfig
menu "PinOut"
    config SPI_HOST
        int "Spi host"
        default 3
    config SPI_MOSI
        int "Spi mosi pin"
        default 23

    config SPI_MISO
        int "Spi miso pin"
        default 19

    config SPI_SCK
        int "Spi sck pin"
        default 18

    config LORA_D0
        int "LoRa DIO0 pin"
        default 17

    config LORA_RS
        int "LoRa reset pin"
        default 17

    config LORA_CS
        int "LoRa cs pin"
        default 4

    config SD_CS
        int "SD cs pin"
        default 5

    config SCL_COM
        int "I2C num 1 sck pin"
        default 26

    config SDA_COM
        int "I2C num 1 sda pin"
        default 27

    config SCL_SEN
        int "I2C num 2 sck pin"
        default 21

    config SDA_SEN
        int "I2C num 2 sda pin"
        default 22

    config UART_TX
        int "UART tx pin"
        default 17

    config UART_RX
        int "UART rx pin"
        default 16

    config UART_BAUDRATE
        int "Uart communication baudrate"
        default 9600

    config UART_PORT_NUM
        int "Uart port number"
        range 0 2
        default 2

endmenu
```
